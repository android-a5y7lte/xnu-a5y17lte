## configs/a5y17lte_defconfig
```kconfig
CONFIG_POSITION_INDEPENDENT=y
# CONFIG_COMPRESS_GZIP is not set
CONFIG_EXYNOS_7880=y
CONFIG_SAMSUNG_A5Y17LTE=y
CONFIG_A5Y17LTE_DIAG_HALT=y
CONFIG_TEXT_BASE=0x47000000
CONFIG_PAYLOAD_ENTRY=0x50000000
CONFIG_RAMDISK_ENTRY=0x42000000
```

## mainline/a5y17lte.its
```
/dts-v1/;

/ {
	description = "Galaxy A5 (2017) mainline Linux, milestone 5";
	#address-cells = <1>;

	images {
		kernel {
			description = "Linux (mainline)";
			data = /incbin/("Image");
			type = "kernel";
			arch = "arm64";
			os = "linux";
			compression = "none";
			load = <0x48200000>;
			entry = <0x48200000>;
			hash { algo = "sha256"; };
		};

		fdt {
			description = "exynos7880-a5y17lte.dtb";
			data = /incbin/("exynos7880-a5y17lte.dtb");
			type = "flat_dt";
			arch = "arm64";
			compression = "none";
			hash { algo = "sha256"; };
		};

		ramdisk {
			description = "test initramfs";
			data = /incbin/("initramfs.cpio.gz");
			type = "ramdisk";
			arch = "arm64";
			os = "linux";
			compression = "none";
			hash { algo = "sha256"; };
		};

		bootscript {
			description = "U-Boot boot script";
			data = /incbin/("boot.cmd");
			type = "script";
			compression = "none";
		};
	};

	configurations {
		default = "a5y17lte";

		a5y17lte {
			description = "Galaxy A5 (2017)";
			kernel = "kernel";
			fdt = "fdt";
			ramdisk = "ramdisk";
		};
	};
};
```
